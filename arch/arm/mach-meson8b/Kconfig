## arch/arm/mach-meson8b/Kconfig
```kconfig
if ARCH_MESON8B

config CLKTREE_DEBUG
	bool "New clock tree debug support"
	default y
	help
		Create a node /sys/class/meson_clocktree/clkTree to get/set clocks

config MESON_CPU_TEMP_SENSOR
	bool "meson temperature sensor cpu interface support"
	default n
	help
		/sys/class/saradc/temperature can got the celius . 

config MESON_SUSPEND_FIRMWARE_BASE
        hex
        default 0x04f00000
        depends on MESON_SUSPEND
        help
          The base address of 1MB of memory reserved for suspend firmware.

config MESON_TRUSTZONE
	bool "Enable ARM Trustzone secure extension"
	default n
	help
		Enable ARM Trustzone secure extension
config MESON8B_TH0
	bool "th0 spec board"
	default n
	help
		make th0 board different with others

config MESON8B_TH8
	bool "th8 spec board"
	default n
	help
		make th8 board different with others

config MESON8B_512M_TH01
	bool "512m th01 spec board"
	default n
	help
		make th0 board different with others

config MESON8B_512M_TH8
	bool "512m th8 spec board"
	default n
	help
		make th8 board different with others
config MESON8B_TH12
        bool "m201_th12 spec board"
        default n
        help
        	make th12 board different with others
endif # ARCH_MESON8
```

## common/drivers/amlogic/shutdown/Kconfig
```kconfig
#support amlogic external module power control

menu "Amlogic shutdown info"

config AMLOGIC_SHUTDOWN
	tristate "Amlogic shutdown info"
	default n
	help
	  Amlogic shutdown info	  
endmenu
```

## drivers/amlogic/gpio/Kconfig
```kconfig
# Amlogic GPIO


config GPIO_AMLOGIC
    bool "GPIO support"
    select ARCH_REQUIRE_GPIOLIB
    select GPIO_SYSFS
    default y
    help
      This is the Amlogic GPIO interface driver
```
